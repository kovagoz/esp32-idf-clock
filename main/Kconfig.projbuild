## main/Kconfig.projbuild
```kconfig
menu "Clock Configuration"

menu "WiFi settings"

config CLOCK_WIFI_SSID
	string "WiFi SSID"

config CLOCK_WIFI_PASSWORD
	string "WiFi password"

endmenu

menu "7-segment LED display"

config CLOCK_DISPLAY_CLK_PIN
    int "LED display CLK pin GPIO number"
    range 0 34
    default 18
    help
        GPIO number (IOxx) for CLK pin of TM1637 display.

        Some GPIOs are used for other purposes (flash connections, etc.) and cannot be used.

        GPIOs 35-39 are input-only so cannot be used to drive the One Wire Bus.

        For ESP8266, GPIO 5 is a good choice.

config CLOCK_DISPLAY_DIO_PIN
    int "LED display DIO pin GPIO number"
    range 0 34
    default 19
    help
        GPIO number (IOxx) for DIO pin of TM1637 display.

        Some GPIOs are used for other purposes (flash connections, etc.) and cannot be used.

        GPIOs 35-39 are input-only so cannot be used to drive the One Wire Bus.

        For ESP8266, GPIO 4 is a good choice.

config CLOCK_DISPLAY_BRIGHTNESS
	int "Display brightness level"
	range 0 7
	default 1

endmenu

config CLOCK_BUTTON_PIN
	int "Button GPIO pin"
    range 0 34

config CLOCK_DHT_PIN
	int "Temperature sensor data pin"
    range 0 34

menu "Laser PM2.5 Sensor"

config CLOCK_SDS011_UART
	int "UART you want to use for communication"
    range 0 2

config CLOCK_SDS011_TX_PIN
	int "UART TX pin number"
    range 0 34

config CLOCK_SDS011_RX_PIN
	int "UART RX pin number"
    range 0 34

config CLOCK_SDS011_RUN_INTERVAL
	int "Time in seconds to let the SDS011 run before taking the measurment"
	range 5 15
	default 5

endmenu

endmenu
```
